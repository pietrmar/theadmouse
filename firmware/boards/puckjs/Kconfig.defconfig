## firmware/boards/puckjs/Kconfig.puckjs
```kconfig
# Copyright (c) 2025 Martin Pietryka
# SPDX-License-Identifier: Apache-2.0

config BOARD_PUCKJS
	select SOC_NRF52832_QFAA
```

## firmware/boards/puckjs/puckjs_defconfig
```kconfig
# SPDX-License-Identifier: Apache-2.0

CONFIG_ARM_MPU=y
CONFIG_HW_STACK_PROTECTION=y

CONFIG_CONSOLE=y
CONFIG_UART_CONSOLE=y

# The Puck.js does not have an external 32.768 kHz oscillator
CONFIG_CLOCK_CONTROL_NRF_K32SRC_RC=y

CONFIG_GPIO=y

CONFIG_SERIAL=y

CONFIG_PWM=y

CONFIG_LED=y
CONFIG_LED_PWM=y

CONFIG_I2C=y

CONFIG_SENSOR=y

CONFIG_LSM6DSL_TRIGGER_OWN_THREAD=y
CONFIG_LSM6DSL_THREAD_PRIORITY=5
```

## firmware/boards/theadmouse/Kconfig.theadmouse
```kconfig
# Copyright (c) 2025 Martin Pietryka
# SPDX-License-Identifier: Apache-2.0

config BOARD_THEADMOUSE
	select SOC_NRF52840_QIAA
```

## firmware/boards/theadmouse/board.yml
```yaml
board:
  name: theadmouse
  socs:
  - name: nrf52840
  revision:
    format: letter
    default: "A"
    revisions:
      - name: "A"
```

## firmware/boards/theadmouse/theadmouse_defconfig
```kconfig
# SPDX-License-Identifier: Apache-2.0

CONFIG_ARM_MPU=y
CONFIG_HW_STACK_PROTECTION=y

CONFIG_CONSOLE=y
CONFIG_UART_CONSOLE=y

CONFIG_GPIO=y

CONFIG_SERIAL=y

CONFIG_PWM=y

CONFIG_LED=y
CONFIG_LED_PWM=y

CONFIG_I2C=y
CONFIG_SPI=y

CONFIG_SENSOR=y

CONFIG_LSM6DSL_TRIGGER_OWN_THREAD=y
CONFIG_LSM6DSL_THREAD_PRIORITY=5

CONFIG_LIS2MDL_MAG_ODR_RUNTIME=y

CONFIG_USB_DEVICE_STACK=y
CONFIG_USB_DEVICE_INITIALIZE_AT_BOOT=y

# From pid.codes, pending pull request:
# https://github.com/pidcodes/pidcodes.github.com/pull/1112
CONFIG_USB_DEVICE_VID=0x1209
CONFIG_USB_DEVICE_PID=0x7EAD
```

## firmware/drivers/charger/Kconfig
```kconfig
# Copyright 2024 Google LLC
#
# SPDX-License-Identifier: Apache-2.0

if CHARGER

config CHARGER_BQ2518X_CUSTOM
	bool "BQ2518x Battery Charger (customized)"
	default y
	depends on DT_HAS_TI_BQ25180_ENABLED || DT_HAS_TI_BQ25186_ENABLED || \
		DT_HAS_TI_BQ25188_ENABLED
	select I2C
	help
	  Enable BQ2518x battery charger driver.

endif # CHARGER
```
